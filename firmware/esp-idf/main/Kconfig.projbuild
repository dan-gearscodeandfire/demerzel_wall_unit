## firmware/esp-idf/main/Kconfig.projbuild
```kconfig
menu "DWU Configuration"

    config DWU_WIFI_SSID
        string "WiFi SSID"
        default "okfrederick"

    config DWU_WIFI_PASS
        string "WiFi password"
        default ""

    config DWU_OKDEMERZEL_HOST
        string "okDemerzel server IP"
        default "192.168.1.156"

    config DWU_OKDEMERZEL_PORT
        int "Voice server port"
        default 8900

    config DWU_ROOM_NAME
        string "Room name (mDNS hostname: dwu-<name>)"
        default "den"

    config DWU_MIC_ID
        string "Mic ID (sent in request headers)"
        default "dwu-den"

    config DWU_LOG_TCP_PORT
        int "TCP log server port"
        default 8901

    config DWU_RECORD_SECONDS
        int "Recording duration (seconds, fixed-window fallback)"
        default 8
        help
            Fallback fixed-window recording duration used only when
            DWU_VAD_ENABLED=n. With VAD the utterance length is decided
            by end-of-speech detection up to DWU_VAD_MAX_RECORD_SECONDS.

    config DWU_VAD_ENABLED
        bool "Use VAD-bounded recording (esp_vad.h)"
        default y
        help
            When enabled, voice_turn records until the VAD reports
            DWU_VAD_HANGOVER_MS of trailing silence (end-of-utterance).
            When disabled, falls back to the fixed DWU_RECORD_SECONDS
            window.

    config DWU_VAD_MAX_RECORD_SECONDS
        int "Max recording length with VAD (seconds)"
        default 15
        depends on DWU_VAD_ENABLED
        help
            Hard cap on how long a single utterance can be. Buffer is
            sized for this in PSRAM (~2 * 16000 * N bytes).

    config DWU_VAD_MODE
        int "VAD aggressiveness mode (UNUSED — kept for sdkconfig compat)"
        default 4
        range 0 4
        depends on DWU_VAD_ENABLED
        help
            Not wired up since 2026-04-22 — WebRTC-port esp_vad.h
            classifies motor/HVAC rumble as speech at every mode in
            real DWU environments. Capture now uses energy-threshold
            end-of-utterance (see DWU_VAD_SPEECH_ENERGY_THRESHOLD).

    config DWU_VAD_SPEECH_ENERGY_THRESHOLD
        int "Mean-square energy for 'frame is speech' (int16 squared)"
        default 30000000
        depends on DWU_VAD_ENABLED
        help
            Per-20ms-frame pcm_meansq threshold. Frames at/above =
            speech, below = silence. Tuning reference from observed
            den environment: idle 20-40M, mic-near speech 100-350M,
            motor/HVAC bursts 60-150M. Default 30M sits just above
            quiet-room ambient. Raise if noise false-triggers onset,
            lower if quiet speech ends captures prematurely.

    config DWU_VAD_HANGOVER_MS
        int "Silence ms after speech to end utterance"
        default 800
        depends on DWU_VAD_ENABLED
        help
            After the first VAD_SPEECH frame, once this many ms of
            continuous VAD_SILENCE is observed, capture stops. 800 ms
            covers typical inter-word pauses without truncating.

    config DWU_VAD_MIN_UTTERANCE_MS
        int "Reject utterances shorter than this (ms)"
        default 300
        depends on DWU_VAD_ENABLED
        help
            If total speech duration is below this, treat the turn as
            a spurious wake (beep_error, skip upload).

    config DWU_VAD_MAX_LEAD_SILENCE_MS
        int "Give up waiting for first speech after this many ms"
        default 2500
        depends on DWU_VAD_ENABLED
        help
            Time budget from capture start until the first VAD_SPEECH.
            If no speech is heard in this window, turn is abandoned.

    config DWU_FOLLOWUP_WINDOW_MS
        int "Followup window duration (ms)"
        default 5000

    config DWU_FOLLOWUP_ENERGY_THRESHOLD
        int "Minimum speech energy threshold for followup (floor)"
        default 30000000
        help
            Floor for the adaptive followup threshold. Per-turn, followup.c
            measures baseline during a 200 ms calibration window right after
            the 1 s settle delay, then uses max(baseline * 3, this value,
            30 M) as the speech threshold. Observed values: quiet room
            6-30 M, ambient chatter 60-250 M, direct speech into mic
            100-350 M. Bump this up for environments where you want
            followup to require louder speech regardless of ambient.

    config DWU_FOLLOWUP_DEBOUNCE_CHUNKS
        int "Consecutive 10ms chunks above threshold to trigger"
        default 8
        help
            Require this many consecutive chunks above the energy threshold
            before declaring speech. 8 = 80ms. Prevents pops/clicks.

    config DWU_TTS_RING_KB
        int "Streaming TTS ring buffer size (KB)"
        default 128
        help
            SPIRAM ring that the ws_client tts_chunk handler pushes into and
            the audio_out writer task drains from. Must hold the ENTIRE
            reply PCM during the pre-activation window (while the ack WAV
            is still playing and the writer task has not yet started) —
            the server pushes all chunks in a burst as soon as synthesis
            completes. 128 KB = ~4 s of 16 kHz mono int16, comfortable for
            a typical multi-sentence slow-class reply. Bump to 256 if you
            see "stream_push dropped" warnings on long responses.

    config DWU_TEST_ALL_DRIVERS
        bool "Run all-driver self-test on boot"
        default n
        help
            When enabled, main.c runs each peripheral driver's self-test
            in sequence instead of the normal voice_turn loop.

endmenu
```

## firmware/esp-idf/sdkconfig.defaults
```kconfig
# Target: ESP32-S3
CONFIG_IDF_TARGET="esp32s3"

# Flash: 16 MB QIO
CONFIG_ESPTOOLPY_FLASHSIZE_16MB=y
CONFIG_ESPTOOLPY_FLASHMODE_QIO=y

# PSRAM: 8 MB OctaSPI
CONFIG_SPIRAM=y
CONFIG_SPIRAM_MODE_OCT=y
CONFIG_SPIRAM_SPEED_80M=y
CONFIG_SPIRAM_TRY_ALLOCATE_WIFI_LWIP=y

# Partition table: dual OTA
CONFIG_PARTITION_TABLE_CUSTOM=y
CONFIG_PARTITION_TABLE_CUSTOM_FILENAME="partitions.csv"

# Bootloader: enable app rollback for OTA
CONFIG_BOOTLOADER_APP_ROLLBACK_ENABLE=y

# Log level
CONFIG_LOG_DEFAULT_LEVEL_INFO=y

# Stack sizes. 32 KB main required — libopus encode exceeds 16 KB even with
# micro-opus's THREADSAFE_PSEUDOSTACK mode. A silent overrun past the
# canary corrupts adjacent TCBs and manifests as a later FreeRTOS assert
# in vTaskGenericNotifyGiveFromISR rather than the canary's clean panic.
CONFIG_ESP_MAIN_TASK_STACK_SIZE=32768
CONFIG_PTHREAD_TASK_STACK_SIZE_DEFAULT=4096

# Watchdog
CONFIG_ESP_TASK_WDT_TIMEOUT_S=30

# Followup window: disabled by default (Session 55, 2026-04-24). Re-enable by
# setting CONFIG_DWU_FOLLOWUP_WINDOW_MS > 0 in sdkconfig once wake-word FP
# rate is confirmed low in your environment. The cascade of a single wake FP
# into 3-4 spurious turns via followup was a major UX issue; disabling it
# breaks that amplification path. followup.c early-returns when WINDOW_MS=0.
CONFIG_DWU_FOLLOWUP_WINDOW_MS=0
```
